## config/kconfig.shield
```kconfig
# No whitespace after the comma or in your part name!
config SHIELD_DACTYL_LEFT
    def_bool $(shields_list_contains,dactyl_left)

# No whitespace after the comma or in your part name!
config SHIELD_DACTYL_RIGHT
    def_bool $(shields_list_contains,dactyl_right)

# No whitespace after the comma or in your part name!
config SHIELD_IRIS_LEFT
    def_bool $(shields_list_contains,iris_left)

# No whitespace after the comma or in your part name!
config SHIELD_IRIS_RIGHT
    def_bool $(shields_list_contains,iris_right)
```
